## v2/firmware/electronbot-zephyr/boards/arm/electronbot_f405/Kconfig.board
```kconfig
# SPDX-License-Identifier: Apache-2.0

config BOARD_ELECTRONBOT_F405
	bool "ElectronBot F405 head board"
	depends on SOC_STM32F405XG
```

## v2/firmware/electronbot-zephyr/boards/arm/electronbot_f405/Kconfig.defconfig
```kconfig
# SPDX-License-Identifier: Apache-2.0

if BOARD_ELECTRONBOT_F405

config BOARD
	default "electronbot_f405"

endif # BOARD_ELECTRONBOT_F405
```

## v2/firmware/electronbot-zephyr/boards/arm/electronbot_f405/electronbot_f405_defconfig
```kconfig
# SPDX-License-Identifier: Apache-2.0
CONFIG_SOC_SERIES_STM32F4X=y
CONFIG_SOC_STM32F405XG=y

# Clocks
CONFIG_CLOCK_CONTROL=y

# Console / UART
CONFIG_SERIAL=y
CONFIG_UART_INTERRUPT_DRIVEN=y

# Buses used by the app
CONFIG_GPIO=y
CONFIG_SPI=y
CONFIG_I2C=y
CONFIG_DMA=y

# FPU
CONFIG_FPU=y

# Enable MPU/flash defaults for the SoC
CONFIG_ARM_MPU=y
```
